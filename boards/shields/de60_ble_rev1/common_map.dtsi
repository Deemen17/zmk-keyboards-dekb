#include <dt-bindings/zmk/matrix_transform.h>

#define MAP_R0_BS_2U        RC(0,0) RC(1,0) RC(0,1) RC(1,1) RC(0,2) RC(1,2) RC(0,3) RC(1,3) RC(0,4) RC(1,4) RC(0,5) RC(1,5) RC(0,6) RC(1,6) 
#define MAP_R0_BS_1U        MAP_R0_BS_2U RC(5,6) 

#define MAP_R1              RC(2,0) RC(3,0) RC(2,1) RC(3,1) RC(2,2) RC(3,2) RC(2,3) RC(3,3) RC(2,4) RC(3,4) RC(2,5) RC(3,5) RC(2,6) RC(3,6) 

#define MAP_R2              RC(4,0) RC(5,0) RC(4,1) RC(5,1) RC(4,2) RC(5,2) RC(4,3) RC(5,3) RC(4,4) RC(5,4) RC(4,5) RC(5,5)         RC(4,6) 

#define WHT_MAP_R3_ISO_L    RC(6,0) RC(7,0) RC(6,1) RC(7,1) RC(6,2) RC(7,2) RC(6,3) RC(7,3) RC(6,4) RC(7,4) RC(6,5) RC(7,5)
#define MAP_R3_ISO_L WHT_MAP_R3_ISO_L
#define MAP_R3_ANSI_L       RC(6,0)         RC(6,1) RC(7,1) RC(6,2) RC(7,2) RC(6,3) RC(7,3) RC(6,4) RC(7,4) RC(6,5) RC(7,5)

#define MAP_R3_R            RC(6,6) RC(7,6) 
#define WHT_MAP_R3_R_275U   RC(6,6) 

#define MAP_R4_ALL_L        RC(8,0) RC(9,0) RC(8,1)                         RC(9,3)       
#define MAP_R4_HHKB_L               RC(9,0) RC(8,1)                         RC(9,3)       
#define MAP_R4_WKL_L        RC(8,0)         RC(8,1)                         RC(9,3)     

#define MAP_R4_10U_wK_L     RC(8,0) RC(9,0)                                 RC(9,3)       
#define MAP_R4_10U_wKL_L    RC(8,0)                                         RC(9,3)       

// Space 625u arrow
#define WHT_MAP_R4_625U_A   RC(8,4) RC(9,5) RC(8,5) RC(9,6) RC(8,6) 
// Space 625u universal
#define WHT_MAP_R4_625U_U   RC(8,4) RC(9,5)         RC(9,6) RC(8,6) 
// Space 625u hhkb
#define WHT_MAP_R4_625U_H   RC(8,4) RC(9,5) RC(8,5) RC(9,6) 

#define WHT_MAP_R4_7U_WK    RC(9,5)         RC(9,6) RC(8,6) 
#define WHT_MAP_R4_7U_WKL   RC(9,5)                 RC(8,6) 
#define WHT_MAP_R4_7U_HHKB  RC(9,5)         RC(9,6) 
#define WHT_MAP_R4_7U_ARROW RC(9,5) RC(8,5) RC(9,6) RC(8,6) 

#define RED_MAP_R4_7U_WK    RC(8,5) RC(9,6) RC(8,6) 
#define RED_MAP_R4_7U_WKL   RC(8,5)         RC(8,6)
#define RED_MAP_R4_7U_HHKB  RC(8,5) RC(9,6) 

#define MAP_R4_10U_WK_R     RC(9,6) RC(8,6) 
#define MAP_R4_10U_WKL_R    RC(8,6) 


// Pre-define Mapping
#define MAP_ALL_R1234_ANSI \
    MAP_R1 \
    MAP_R2 \
    MAP_R3_ANSI_L \
    MAP_R3_R \
    MAP_R4_ALL_L

#define MAP_ALL_R1234_ISO \
    MAP_R1 \
    MAP_R2 \
    MAP_R3_ISO_L \
    MAP_R3_R \
    MAP_R4_ALL_L

#define MAP_ALL_R0_1U_R1234_ANSI \
    MAP_R0_BS_1U \
    MAP_ALL_R1234_ANSI

#define MAP_ALL_R0_2U_R1234_ANSI \
    MAP_R0_BS_2U \
    MAP_ALL_R1234_ANSI

#define MAP_ALL_R0_1U_R1234_ISO \
    MAP_R0_BS_1U \
    MAP_ALL_R1234_ISO

#define MAP_ALL_R0_2U_R1234_ISO \
    MAP_R0_BS_2U \
    MAP_ALL_R1234_ISO

// Red Pre-define Mapping
#define RED_MAP_TSANGAN \
    MAP_ALL_R0_1U_R1234_ANSI \
    RED_MAP_R4_7U_WK

// White Pre-define Mapping
#define WHT_MAP_ALL \
    MAP_ALL_R0_1U_R1234_ISO \
    WHT_MAP_R4_625U_A 
