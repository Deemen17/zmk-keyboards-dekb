#include "common.overlay"

/ {
    chosen {
        zmk,battery = &vbatt;
    };

    vbatt: vbatt {
        compatible = "zmk,battery-voltage-divider";
        io-channels = <&adc 0>; // P0.02 (AIN0)
        output-ohms = <2000000>;
        full-ohms = <(1000000 + 2000000)>;
    };
};
