#include <physical_layouts.dtsi>

// Multi Layouts Defines
//                                           w   h    x    y     rot    rx    ry
#define ROW0_FIXED    <&key_physical_attrs 100 100    0    0       0     0     0> \
                    , <&key_physical_attrs 100 100  100    0       0     0     0> \
                    , <&key_physical_attrs 100 100  200    0       0     0     0> \
                    , <&key_physical_attrs 100 100  300    0       0     0     0> \
                    , <&key_physical_attrs 100 100  400    0       0     0     0> \
                    , <&key_physical_attrs 100 100  500    0       0     0     0> \
                    , <&key_physical_attrs 100 100  600    0       0     0     0> \
                    , <&key_physical_attrs 100 100  700    0       0     0     0> \
                    , <&key_physical_attrs 100 100  800    0       0     0     0> \
                    , <&key_physical_attrs 100 100  900    0       0     0     0> \
                    , <&key_physical_attrs 100 100 1000    0       0     0     0> \
                    , <&key_physical_attrs 100 100 1100    0       0     0     0> \
                    , <&key_physical_attrs 100 100 1200    0       0     0     0>

#define ROW0_BS_2U    <&key_physical_attrs 200 100 1300    0       0     0     0>

#define ROW0_BS_1U    <&key_physical_attrs 100 100 1300    0       0     0     0> \
                    , <&key_physical_attrs 100 100 1400    0       0     0     0>

#define ROW1_FIXED    <&key_physical_attrs 150 100    0  100       0     0     0> \
                    , <&key_physical_attrs 100 100  150  100       0     0     0> \
                    , <&key_physical_attrs 100 100  250  100       0     0     0> \
                    , <&key_physical_attrs 100 100  350  100       0     0     0> \
                    , <&key_physical_attrs 100 100  450  100       0     0     0> \
                    , <&key_physical_attrs 100 100  550  100       0     0     0> \
                    , <&key_physical_attrs 100 100  650  100       0     0     0> \
                    , <&key_physical_attrs 100 100  750  100       0     0     0> \
                    , <&key_physical_attrs 100 100  850  100       0     0     0> \
                    , <&key_physical_attrs 100 100  950  100       0     0     0> \
                    , <&key_physical_attrs 100 100 1050  100       0     0     0> \
                    , <&key_physical_attrs 100 100 1150  100       0     0     0> \
                    , <&key_physical_attrs 100 100 1250  100       0     0     0>

#define ROW1_ANSI     <&key_physical_attrs 150 100 1350  100       0     0     0>

#define ROW1_ISO      <&key_physical_attrs 125 200 1375  100       0     0     0>


#define ROW2_FIXED    <&key_physical_attrs 175 100    0  200       0     0     0> \
                    , <&key_physical_attrs 100 100  175  200       0     0     0> \
                    , <&key_physical_attrs 100 100  275  200       0     0     0> \
                    , <&key_physical_attrs 100 100  375  200       0     0     0> \
                    , <&key_physical_attrs 100 100  475  200       0     0     0> \
                    , <&key_physical_attrs 100 100  575  200       0     0     0> \
                    , <&key_physical_attrs 100 100  675  200       0     0     0> \
                    , <&key_physical_attrs 100 100  775  200       0     0     0> \
                    , <&key_physical_attrs 100 100  875  200       0     0     0> \
                    , <&key_physical_attrs 100 100  975  200       0     0     0> \
                    , <&key_physical_attrs 100 100 1075  200       0     0     0> \
                    , <&key_physical_attrs 100 100 1175  200       0     0     0>

#define ROW2_ANSI     <&key_physical_attrs 225 100 1275  200       0     0     0>

#define ROW2_ISO      <&key_physical_attrs 100 100 1275  200       0     0     0>

#define ROW3_ANSI     <&key_physical_attrs 225 100    0  300       0     0     0>

#define ROW3_ISO      <&key_physical_attrs 125 100    0  300       0     0     0> \
                    , <&key_physical_attrs 100 100  125  300       0     0     0>

#define ROW3_FIXED    <&key_physical_attrs 100 100  225  300       0     0     0> \
                    , <&key_physical_attrs 100 100  325  300       0     0     0> \
                    , <&key_physical_attrs 100 100  425  300       0     0     0> \
                    , <&key_physical_attrs 100 100  525  300       0     0     0> \
                    , <&key_physical_attrs 100 100  625  300       0     0     0> \
                    , <&key_physical_attrs 100 100  725  300       0     0     0> \
                    , <&key_physical_attrs 100 100  825  300       0     0     0> \
                    , <&key_physical_attrs 100 100  925  300       0     0     0> \
                    , <&key_physical_attrs 100 100 1025  300       0     0     0>

#define ROW3_RS_275U  <&key_physical_attrs 100 100 1125  300       0     0     0> \
                    , <&key_physical_attrs 275 100 1225  300       0     0     0>

#define ROW3_RS_175U  <&key_physical_attrs 100 100 1125  300       0     0     0> \
                    , <&key_physical_attrs 175 100 1225  300       0     0     0> \
                    , <&key_physical_attrs 100 100 1400  300       0     0     0>

#define ROW3_RS_ARROW <&key_physical_attrs 175 100 1125  300       0     0     0> \
                    , <&key_physical_attrs 100 100 1300  300       0     0     0> \
                    , <&key_physical_attrs 100 100 1400  300       0     0     0>


#define SPC_625U_ARROW <&key_physical_attrs 125 100    0  400       0     0     0> \
                    , <&key_physical_attrs 125 100  125  400       0     0     0> \
                    , <&key_physical_attrs 125 100  250  400       0     0     0> \
                    , <&key_physical_attrs 625 100  375  400       0     0     0> \
                    , <&key_physical_attrs 100 100 1000  400       0     0     0> \
                    , <&key_physical_attrs 100 100 1100  400       0     0     0> \
                    , <&key_physical_attrs 100 100 1200  400       0     0     0> \
                    , <&key_physical_attrs 100 100 1300  400       0     0     0> \
                    , <&key_physical_attrs 100 100 1400  400       0     0     0>

#define SPC_625U_UNI  <&key_physical_attrs 125 100    0  400       0     0     0> \
                    , <&key_physical_attrs 125 100  125  400       0     0     0> \
                    , <&key_physical_attrs 125 100  250  400       0     0     0> \
                    , <&key_physical_attrs 625 100  375  400       0     0     0> \
                    , <&key_physical_attrs 125 100 1000  400       0     0     0> \
                    , <&key_physical_attrs 125 100 1125  400       0     0     0> \
                    , <&key_physical_attrs 125 100 1250  400       0     0     0> \
                    , <&key_physical_attrs 125 100 1375  400       0     0     0>

#define SPC_625U_HHKB <&key_physical_attrs 100 100  150  400       0     0     0> \
                    , <&key_physical_attrs 125 100  250  400       0     0     0> \
                    , <&key_physical_attrs 625 100  375  400       0     0     0> \
                    , <&key_physical_attrs 125 100 1000  400       0     0     0> \
                    , <&key_physical_attrs 125 100 1125  400       0     0     0> \
                    , <&key_physical_attrs 100 100 1250  400       0     0     0>

#define SPC_7U_WK     <&key_physical_attrs 150 100    0  400       0     0     0> \
                    , <&key_physical_attrs 100 100  150  400       0     0     0> \
                    , <&key_physical_attrs 150 100  250  400       0     0     0> \
                    , <&key_physical_attrs 700 100  400  400       0     0     0> \
                    , <&key_physical_attrs 150 100 1100  400       0     0     0> \
                    , <&key_physical_attrs 100 100 1250  400       0     0     0> \
                    , <&key_physical_attrs 150 100 1350  400       0     0     0>

#define SPC_7U_ARROW  <&key_physical_attrs 150 100    0  400       0     0     0> \
                    , <&key_physical_attrs 150 100  150  400       0     0     0> \
                    , <&key_physical_attrs 150 100  300  400       0     0     0> \
                    , <&key_physical_attrs 700 100  400  400       0     0     0> \
                    , <&key_physical_attrs 100 100 1100  400       0     0     0> \
                    , <&key_physical_attrs 100 100 1200  400       0     0     0> \
                    , <&key_physical_attrs 100 100 1300  400       0     0     0> \
                    , <&key_physical_attrs 100 100 1400  400       0     0     0>

#define SPC_7U_HHKB   <&key_physical_attrs 150 100  150  400       0     0     0> \
                    , <&key_physical_attrs 150 100  300  400       0     0     0> \
                    , <&key_physical_attrs 700 100  450  400       0     0     0> \
                    , <&key_physical_attrs 150 100 1150  400       0     0     0> \
                    , <&key_physical_attrs 100 100 1300  400       0     0     0>

#define SPC_7U_WKL    <&key_physical_attrs 150 100    0  400       0     0     0> \
                    , <&key_physical_attrs 150 100  250  400       0     0     0> \
                    , <&key_physical_attrs 700 100  400  400       0     0     0> \
                    , <&key_physical_attrs 150 100 1100  400       0     0     0> \
                    , <&key_physical_attrs 150 100 1350  400       0     0     0> \

#define SPC_10U_WK    <&key_physical_attrs 150 100    0  400       0     0     0> \
                    , <&key_physical_attrs 100 100  150  400       0     0     0> \
                    , <&key_physical_attrs 1000 100 250  400       0     0     0> \
                    , <&key_physical_attrs 100 100 1250  400       0     0     0> \
                    , <&key_physical_attrs 150 100 1350  400       0     0     0>

#define SPC_10U_WKL   <&key_physical_attrs 150 100    0  400       0     0     0> \
                    , <&key_physical_attrs 1000 100 250  400       0     0     0> \
                    , <&key_physical_attrs 150 100 1350  400       0     0     0>

#define SPC_10U_HHKB  <&key_physical_attrs 100 100  150  400       0     0     0> \
                    , <&key_physical_attrs 1000 100 250  400       0     0     0> \
                    , <&key_physical_attrs 100 100 1250  400       0     0     0>

// Base Layout with all keys in matrix.
/ {
    chosen {
        zmk,physical-layout = &common_layout;
    };

    common_layout: common_layout {
        compatible = "zmk,physical-layout";
        display-name = "COMMON KEYS";
        transform = <&matrix_transform_all>;

        keys =    ROW0_FIXED , ROW0_BS_1U
                , ROW1_FIXED , ROW1_ANSI
                , ROW2_FIXED , ROW2_ANSI
                , ROW3_ANSI  , ROW3_FIXED , ROW3_RS_ARROW
                , SPC_625U_ARROW;
    };
};
