## boards/arm/deemen17_de60_minila/Kconfig.board
```kconfig
# Copyright (c) 2024 Deemen17 Works
# SPDX-License-Identifier: MIT

config BOARD_DE60_MINILA_HS
    bool "de60_minila_hs"
    depends on SOC_NRF52840_QIAA
```
