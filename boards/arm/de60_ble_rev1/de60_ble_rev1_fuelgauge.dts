#include "de60_ble_rev1.dtsi"

/{
    chosen {
        zmk,battery = &fuelgauge;
    };
};

&i2c0 {
    status = "okay";
    compatible = "nordic,nrf-twim";
    pinctrl-0 = <&i2c0_default>;
    pinctrl-1 = <&i2c0_sleep>;
    pinctrl-names = "default", "sleep";
    // clock-frequency = <100000>;
    clock-frequency = <I2C_BITRATE_STANDARD>; // 100kHz

    fuelgauge: max17048@36 {
        compatible = "zmk,maxim-max17048";
        reg = <0x36>;
        status = "okay";
    };
};