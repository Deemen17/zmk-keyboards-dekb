## boards/arm/curve_e/Kconfig.board
```kconfig
# Copyright (c) 2026 DEKB
# SPDX-License-Identifier: Apache-2.0

config BOARD_CURVE_E
    bool "curve_e"
    depends on SOC_NRF52840_QIAA
    
```

## boards/arm/curve_e/Kconfig.defconfig
```kconfig
# Copyright (c) 2026 DEKB

if BOARD_CURVE_E

config BOARD
    default "curve_e"

if USB_DEVICE_STACK

config USB_NRFX
    default y

endif # USB_DEVICE_STACK

config BT_CTLR
    default BT

endif 
```

## boards/arm/de60_ble_proto/Kconfig.board
```kconfig
# Copyright (c) 2026 DEKB
# SPDX-License-Identifier: MIT

config BOARD_DE60_BLE_PROTO
    bool "de60_ble_proto"
    depends on SOC_NRF52840_QIAA
```

## boards/arm/de60_ble_rev1/Kconfig.board
```kconfig
# Copyright (c) 2026 DEKB
# SPDX-License-Identifier: MIT

config BOARD_DE60_BLE_REV1
    bool "de60_ble_rev1"
    depends on SOC_NRF52840_QIAA

config BOARD_DE60_BLE_REV1_FUELGAUGE
    bool "de60_ble_rev1_fuelgauge"
    depends on SOC_NRF52840_QIAA

config BOARD_DE60_BLE_REV1_ADC
    bool "de60_ble_rev1_adc"
    depends on SOC_NRF52840_QIAA
```

## boards/arm/de60_ble_rev1/de60_ble_rev1_defconfig
```kconfig
# Copyright (c) 2020 The ZMK Contributors
# SPDX-License-Identifier: MIT

# BOARD
CONFIG_SOC_SERIES_NRF52X=y
CONFIG_SOC_NRF52840_QIAA=y
CONFIG_BOARD_DE60_BLE_REV1=y

# CORE
CONFIG_ARM_MPU=y
CONFIG_PINCTRL=y
CONFIG_GPIO=y
CONFIG_LED=y
CONFIG_LED_GPIO=y

# FLASH / SETTINGS
CONFIG_USE_DT_CODE_PARTITION=y
CONFIG_BUILD_OUTPUT_UF2=y

CONFIG_NVS=y
CONFIG_SETTINGS_NVS=y

CONFIG_FLASH=y
CONFIG_FLASH_MAP=y
CONFIG_FLASH_PAGE_LAYOUT=y

CONFIG_MPU_ALLOW_FLASH_WRITE=y

# CLOCK
CONFIG_CLOCK_CONTROL_NRF=y
CONFIG_CLOCK_CONTROL_NRF_K32SRC_RC=y

# ============================================================
# USB
# ============================================================

CONFIG_ZMK_USB=y

# USB Identity
CONFIG_USB_DEVICE_VID=0xDE17
CONFIG_USB_DEVICE_PID=0x60B1
CONFIG_USB_DEVICE_MANUFACTURER="DEKB"
CONFIG_USB_DEVICE_SN="dekb.com:DE60-0123456789ABCDEF"
CONFIG_ZMK_KEYBOARD_NAME="DE60 BLE REV1"

# BIOS / UEFI compatibility
CONFIG_ZMK_USB_BOOT=n
CONFIG_USB_HID_BOOT_PROTOCOL=n

# ============================================================
# BLE
# ============================================================

CONFIG_ZMK_BLE=y

# Device Identity
CONFIG_BT_DEVICE_NAME="DE60 BLE REV1"
CONFIG_BT_DEVICE_NAME_MAX=23

# Device information
CONFIG_BT_DIS_PNP_PID=0xDE17
CONFIG_BT_DIS_PNP_VID=0x60B1
CONFIG_BT_DIS_MANUF="DEKB"
CONFIG_BT_DIS_MODEL="DE60 BLE REV1"

# Radio 
CONFIG_BT_CTLR_PHY_2M=y
CONFIG_BT_CTLR_TX_PWR_PLUS_8=y

# MTU
CONFIG_BT_CTLR_DATA_LENGTH_MAX=251
CONFIG_BT_BUF_ACL_TX_SIZE=251
CONFIG_BT_BUF_ACL_RX_SIZE=251
CONFIG_BT_L2CAP_TX_MTU=247

# Faster BLE response
CONFIG_BT_GAP_PERIPHERAL_PREF_PARAMS=y
CONFIG_BT_PERIPHERAL_PREF_MIN_INT=6
CONFIG_BT_PERIPHERAL_PREF_MAX_INT=9
CONFIG_BT_PERIPHERAL_PREF_LATENCY=0
CONFIG_BT_PERIPHERAL_PREF_TIMEOUT=400

# BLE TX queue + Studio RPC buffer
CONFIG_BT_L2CAP_TX_BUF_COUNT=10

# Experimental BLE
CONFIG_ZMK_BLE_EXPERIMENTAL_CONN=y
CONFIG_ZMK_BLE_EXPERIMENTAL_FEATURES=y
CONFIG_ZMK_BLE_PASSKEY_ENTRY=y

# ============================================================
# HID
# ============================================================

CONFIG_ZMK_HID_REPORT_TYPE_NKRO=y
CONFIG_ZMK_HID_INDICATORS=y
CONFIG_ZMK_HID_SEPARATE_MOD_RELEASE_REPORT=y
CONFIG_ZMK_HID_CONSUMER_REPORT_USAGES_FULL=y
# CONFIG_ZMK_HID_CONSUMER_REPORT_USAGES_BASIC=y

# ============================================================
# POWER MANAGEMENT
# ============================================================

# Go to idle after 1 mins (1*60*1000ms)
CONFIG_ZMK_IDLE_TIMEOUT=60000

# Go to sleep after 30 mins (30*60*1000ms)
CONFIG_ZMK_IDLE_SLEEP_TIMEOUT=1800000

CONFIG_ZMK_IDLE_SKIP_ON_USB_POWER=y
CONFIG_ZMK_SLEEP=y
CONFIG_ZMK_PM_SOFT_OFF=y

# ============================================================
# KEY SCAN
# ============================================================

CONFIG_ZMK_KSCAN_DEBOUNCE_PRESS_MS=2
CONFIG_ZMK_KSCAN_DEBOUNCE_RELEASE_MS=3

# ============================================================
# RGB UNDERGLOW
# ============================================================

CONFIG_ZMK_RGB_UNDERGLOW=y
CONFIG_WS2812_STRIP=y

CONFIG_ZMK_EXT_POWER=y
CONFIG_ZMK_RGB_UNDERGLOW_EXT_POWER=y

CONFIG_ZMK_RGB_UNDERGLOW_AUTO_OFF_USB=y
CONFIG_ZMK_RGB_UNDERGLOW_AUTO_OFF_IDLE=y

CONFIG_ZMK_RGB_UNDERGLOW_BRT_MAX=75

CONFIG_ZMK_RGB_UNDERGLOW_ON_START=y
CONFIG_ZMK_RGB_UNDERGLOW_BRT_START=36
CONFIG_ZMK_RGB_UNDERGLOW_SPD_START=5
CONFIG_ZMK_RGB_UNDERGLOW_EFF_START=0
CONFIG_ZMK_RGB_UNDERGLOW_HUE_START=0
CONFIG_ZMK_RGB_UNDERGLOW_SAT_START=100

# Per-key RGB Layer Effect
CONFIG_EXPERIMENTAL_RGB_LAYER=n

# ============================================================
# BATTERY
# ============================================================

CONFIG_ZMK_BATTERY=y
CONFIG_ZMK_BATTERY_REPORTING=y

CONFIG_BT_BAS=y

# ============================================================
# I2C
# ============================================================

CONFIG_I2C=y
CONFIG_I2C_NRFX=y

# ============================================================
# PWM / BUZZER
# ============================================================

CONFIG_PWM=y
CONFIG_PWM_NRFX=y

# ============================================================
# POINTING
# ============================================================

CONFIG_ZMK_POINTING=y
CONFIG_ZMK_POINTING_SMOOTH_SCROLLING=y


# ============================================================
# ZMK STUDIO
# ============================================================

CONFIG_ZMK_STUDIO=y

CONFIG_ZMK_STUDIO_LOCKING=n
CONFIG_ZMK_STUDIO_LOCK_ON_DISCONNECT=n

CONFIG_ZMK_STUDIO_RPC_TX_BUF_SIZE=256
CONFIG_ZMK_STUDIO_RPC_THREAD_STACK_SIZE=8192

# ============================================================
# MEMORY
# ============================================================

CONFIG_HEAP_MEM_POOL_SIZE=32768
CONFIG_SYSTEM_WORKQUEUE_STACK_SIZE=4096
```

## boards/arm/de60_ble_rev1_red/Kconfig.board
```kconfig
# Copyright (c) 2026 DEKB
# SPDX-License-Identifier: MIT

config BOARD_DE60_BLE_REV1_RED
    bool "de60_ble_rev1_red"
    depends on SOC_NRF52840_QIAA
```

## boards/arm/de60_ble_rev1_rel/Kconfig.board
```kconfig
# Copyright (c) 2026 DEKB
# SPDX-License-Identifier: MIT

config BOARD_DE60_BLE_REV1_REL
    bool "de60_ble_rev1_rel"
    depends on SOC_NRF52840_QIAA
```

## boards/arm/de60_ble_rev1_rel/Kconfig.defconfig
```kconfig
# Copyright (c) 2026 DEKB
# SPDX-License-Identifier: MIT

if BOARD_DE60_BLE_REV1_REL

config BOARD
    default "de60_ble_rev1_rel"

if USB

config USB_NRFX
    default y

config USB_DEVICE_STACK
	default y

config USB_DEVICE_MANUFACTURER
	default "DEKB"

endif # USB

if BT

config BT_DIS_MANUF
	default "DEKB"

config BT_DIS_MODEL
	default "DE60 BLE REV1"

endif # BT

config BT_CTLR
	default BT

config ZMK_BLE
	default y

config ZMK_USB
	default y

endif # BOARD_DE60_BLE_REV1_REL
```

## boards/arm/de60_ble_rev1_rel/de60_ble_rev1_rel_defconfig
```kconfig
# Copyright (c) 2020 The ZMK Contributors
# SPDX-License-Identifier: MIT

CONFIG_SOC_SERIES_NRF52X=y
CONFIG_SOC_NRF52840_QIAA=y
CONFIG_BOARD_DE60_BLE_REV1_REL=y

CONFIG_ARM_MPU=y
CONFIG_PINCTRL=y
CONFIG_GPIO=y
CONFIG_LED=y
CONFIG_LED_GPIO=y

CONFIG_USE_DT_CODE_PARTITION=y
CONFIG_BUILD_OUTPUT_UF2=y

CONFIG_MPU_ALLOW_FLASH_WRITE=y
CONFIG_NVS=y
CONFIG_SETTINGS_NVS=y
CONFIG_FLASH=y
CONFIG_FLASH_PAGE_LAYOUT=y
CONFIG_FLASH_MAP=y
CONFIG_CLOCK_CONTROL_NRF=y
CONFIG_CLOCK_CONTROL_NRF_K32SRC_RC=y

# USB
CONFIG_ZMK_USB=y
CONFIG_USB_DEVICE_VID=0xDE17
CONFIG_USB_DEVICE_PID=0x60B1
CONFIG_USB_DEVICE_MANUFACTURER="DEKB"
CONFIG_ZMK_KEYBOARD_NAME="DE60 BLE REV1"

# BLE
CONFIG_ZMK_BLE=y
CONFIG_BT_DEVICE_NAME_MAX=23
CONFIG_BT_DEVICE_NAME="DE60 BLE REV1"
CONFIG_ZMK_BLE_EXPERIMENTAL_CONN=y
CONFIG_BT_CTLR_TX_PWR_PLUS_8=y

# POWER MANAGEMENT
# Default Idle Timeout: 5 minutes
CONFIG_ZMK_IDLE_TIMEOUT=300000
CONFIG_ZMK_SLEEP=y
# Default Idle Sleep Timeout: 60 minutes
CONFIG_ZMK_IDLE_SLEEP_TIMEOUT=3600000
CONFIG_ZMK_PM_SOFT_OFF=y
CONFIG_ZMK_EXT_POWER=y

# HID
CONFIG_ZMK_HID_CONSUMER_REPORT_USAGES_FULL=y
# CONFIG_ZMK_HID_GENERIC_DESKTOP_USAGES_BASIC=y
CONFIG_ZMK_HID_INDICATORS=y

# DEBOUNCE
CONFIG_ZMK_KSCAN_DEBOUNCE_PRESS_MS=3
CONFIG_ZMK_KSCAN_DEBOUNCE_RELEASE_MS=5

# STUDIO
CONFIG_ZMK_STUDIO=y
CONFIG_ZMK_STUDIO_LOCKING=n
CONFIG_ZMK_STUDIO_LOCK_ON_DISCONNECT=n

# RGB UNDERGLOW
CONFIG_WS2812_STRIP=y
CONFIG_ZMK_RGB_UNDERGLOW=y
CONFIG_ZMK_RGB_UNDERGLOW_EXT_POWER=y
CONFIG_ZMK_RGB_UNDERGLOW_AUTO_OFF_IDLE=y
CONFIG_ZMK_RGB_UNDERGLOW_EFF_START=3
CONFIG_ZMK_RGB_UNDERGLOW_SPD_START=5

# BATTERY REPORTING
CONFIG_ZMK_BATTERY=y
CONFIG_ZMK_BATTERY_REPORTING=y
CONFIG_FUEL_GAUGE=y

# FUEL GAUGE 
CONFIG_I2C=y
CONFIG_I2C_NRFX=y
CONFIG_ZMK_MAX17048=y

# BUZZER (PWM) 
CONFIG_PWM=y
CONFIG_PWM_NRFX=y

# POINTING DEVICE
CONFIG_ZMK_POINTING=y
CONFIG_ZMK_POINTING_SMOOTH_SCROLLING=y


# CONFIG_BOOT_DELAY=100
```

## boards/arm/de60_ble_rev1_white/Kconfig.board
```kconfig
# Copyright (c) 2026 DEKB
# SPDX-License-Identifier: MIT

config BOARD_DE60_BLE_REV1_WHITE
    bool "de60_ble_rev1_white"
    depends on SOC_NRF52840_QIAA
```

## boards/arm/de_core_nrf52/Kconfig.board
```kconfig
# Copyright (c) 2026 DEKB
# SPDX-License-Identifier: Apache-2.0

config BOARD_DE_CORE_NRF52
    bool "de_core_nrf52"
    depends on SOC_NRF52840_QIAA
    
```

## boards/arm/de_core_nrf52/Kconfig.defconfig
```kconfig
# Copyright (c) 2026 DEKB

if BOARD_DE_CORE_NRF52

config BOARD
    default "de_core_nrf52"

if USB_DEVICE_STACK

config USB_NRFX
    default y

endif # USB_DEVICE_STACK

config BT_CTLR
    default BT

endif 
```

## boards/arm/de_nrf52840/Kconfig.board
```kconfig
# Copyright (c) 2026 DEKB
# SPDX-License-Identifier: Apache-2.0

config BOARD_DE_NRF52840
    bool "de_nrf52840"
    depends on SOC_NRF52840_QIAA
    
```

## boards/arm/de_nrf52840/Kconfig.defconfig
```kconfig
# Copyright (c) 2026 DEKB

if BOARD_DE_NRF52840

config BOARD
    default "de_nrf52840"

if USB_DEVICE_STACK

config USB_NRFX
    default y

endif # USB_DEVICE_STACK

config BT_CTLR
    default BT

endif 
```

## boards/arm/deky65/deky65_defconfig
```kconfig
# Copyright (c) 2025 Deemen17 Works
# SPDX-License-Identifier: MIT

# DEFAULT
CONFIG_SOC_SERIES_NRF52X=y
CONFIG_SOC_NRF52840_QIAA=y
CONFIG_ARM_MPU=y
CONFIG_PINCTRL=y
CONFIG_GPIO=y
CONFIG_LED=y
CONFIG_LED_GPIO=y
CONFIG_USE_DT_CODE_PARTITION=y
CONFIG_BUILD_OUTPUT_UF2=y
CONFIG_MPU_ALLOW_FLASH_WRITE=y
CONFIG_NVS=y
CONFIG_SETTINGS_NVS=y
CONFIG_FLASH=y
CONFIG_FLASH_PAGE_LAYOUT=y
CONFIG_FLASH_MAP=y
CONFIG_CLOCK_CONTROL_NRF=y
CONFIG_CLOCK_CONTROL_NRF_K32SRC_RC=y
CONFIG_CLOCK_CONTROL_NRF_K32SRC_500PPM=y

# BOARD
CONFIG_BOARD_DEKY65=y

# USB
CONFIG_ZMK_USB=y
CONFIG_USB_DEVICE_VID=0xDE17
CONFIG_USB_DEVICE_PID=0x65BE
CONFIG_USB_DEVICE_MANUFACTURER="DEKB"
CONFIG_ZMK_KEYBOARD_NAME="DEKY65"

# BLE
CONFIG_ZMK_BLE=y
CONFIG_BT_DEVICE_NAME_MAX=23
CONFIG_BT_DEVICE_NAME="DEKY65 BLE"
CONFIG_BT_SETTINGS=y
CONFIG_BT_CTLR_TX_PWR_PLUS_8=y
CONFIG_ZMK_BLE_EXPERIMENTAL_CONN=y

# POWER MANAGEMENT
# Idle timeout: 5 minutes
CONFIG_ZMK_IDLE_TIMEOUT=300000
CONFIG_ZMK_SLEEP=y
# Deep sleep timeout: 30 minutes
CONFIG_ZMK_IDLE_SLEEP_TIMEOUT=1800000
CONFIG_ZMK_PM_SOFT_OFF=y
CONFIG_ZMK_EXT_POWER=y

# HID
CONFIG_ZMK_HID_CONSUMER_REPORT_USAGES_FULL=y
CONFIG_ZMK_HID_INDICATORS=y

# DEBOUNCE
CONFIG_ZMK_KSCAN_DEBOUNCE_PRESS_MS=5
CONFIG_ZMK_KSCAN_DEBOUNCE_RELEASE_MS=5

# STUDIO
CONFIG_ZMK_STUDIO=y
CONFIG_ZMK_STUDIO_LOCKING=n
CONFIG_ZMK_STUDIO_LOCK_ON_DISCONNECT=n

# RGB UNDERGLOW
CONFIG_WS2812_STRIP=n
CONFIG_ZMK_RGB_UNDERGLOW=n
CONFIG_ZMK_RGB_UNDERGLOW_EXT_POWER=n
CONFIG_ZMK_RGB_UNDERGLOW_AUTO_OFF_IDLE=n
CONFIG_ZMK_RGB_UNDERGLOW_EFF_START=3
CONFIG_ZMK_RGB_UNDERGLOW_SPD_START=5

# BATTERY REPORTING (voltage divider)
CONFIG_ZMK_BATTERY_REPORTING=y
CONFIG_ADC=y
CONFIG_ADC_NRFX_SAADC=y

# POINTING DEVICE
CONFIG_ZMK_POINTING=y
CONFIG_ZMK_POINTING_SMOOTH_SCROLLING=y
```

## boards/shields/curve_e/Kconfig.shield
```kconfig
# Copyright (c) 2020 The ZMK Contributors
# SPDX-License-Identifier: MIT

config SHIELD_CURVE_E
    def_bool $(shields_list_contains,curve_e)
    select SPI
```

## boards/shields/de108_ble_proto/Kconfig.defconfig
```kconfig
# Copyright (c) 2026 DEKB
# SPDX-License-Identifier: MIT

if SHIELD_DE108_BLE_PROTO

config ZMK_KEYBOARD_NAME
    default "de108_ble_proto"

config LED
    default y

endif # SHIELD_DE108_BLE_PROTO
```

## boards/shields/de108_ble_proto/Kconfig.shield
```kconfig
# Copyright (c) 2026 DEKB
# SPDX-License-Identifier: MIT

config SHIELD_DE108_BLE_PROTO
    def_bool $(shields_list_contains,de108_ble_proto)
    select SPI
```

## boards/shields/de108_ble_proto/boards/de_core_nrf52.conf
```kconfig
CONFIG_ZMK_RGB_UNDERGLOW=y
CONFIG_WS2812_STRIP=y
CONFIG_ZMK_BATTERY_REPORTING=y
CONFIG_ADC=y
CONFIG_ADC_NRFX_SAADC=y
```

## boards/shields/de60_ble_rev1/Kconfig.shield
```kconfig
# Copyright (c) 2020 The ZMK Contributors
# SPDX-License-Identifier: MIT

config SHIELD_DE60_BLE_REV1_RED
    def_bool $(shields_list_contains,de60_ble_rev1_red)
    select SPI

config SHIELD_DE60_BLE_REV1_WHITE_ANSI_7U
    def_bool $(shields_list_contains,de60_ble_rev1_white_ansi_7u)
    select SPI 

config SHIELD_DE60_BLE_REV1_WHITE_ANSI_10U
    def_bool $(shields_list_contains,de60_ble_rev1_white_ansi_10u)
    select SPI 

config SHIELD_DE60_BLE_REV1_WHITE_ANSI_625U
    def_bool $(shields_list_contains,de60_ble_rev1_white_ansi_625u)
    select SPI  

config SHIELD_DE60_BLE_REV1_WHITE_ISO_7U
    def_bool $(shields_list_contains,de60_ble_rev1_white_iso_7u)
    select SPI 

config SHIELD_DE60_BLE_REV1_WHITE_ISO_625U
    def_bool $(shields_list_contains,de60_ble_rev1_white_iso_625u)
    select SPI 

config SHIELD_DE60_BLE_REV1_WHITE_ISO_10U
    def_bool $(shields_list_contains,de60_ble_rev1_white_iso_10u)
    select SPI 
```

## boards/shields/dengle/Kconfig.defconfig
```kconfig
if SHIELD_DENGLE

config ZMK_KEYBOARD_NAME
    default "DENGLE"

config ZMK_USB
    default y

config ZMK_BLE
    default n

endif
```

## config/west.yml
```yaml
manifest:
  defaults:
    revision: v0.3
  remotes:
    - name: zmkfirmware
      url-base: https://github.com/zmkfirmware/
    - name: phdesign
      url-base: https://github.com/ph-design/
  projects:
    - name: zmk
      remote: phdesign
      revision: v0.3-lts
      import: app/west.yml
  self:
    path: config
```
